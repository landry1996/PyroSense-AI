## firmware/pyrosense-device/sdkconfig.defaults
```kconfig
# PyroSense Device - Default SDK Configuration
# Framework: ESP-IDF 5.x / FreeRTOS

# --- System ---
CONFIG_IDF_TARGET="esp32s3"
CONFIG_ESP_DEFAULT_CPU_FREQ_MHZ=240
CONFIG_FREERTOS_HZ=1000
CONFIG_ESP_TASK_WDT_TIMEOUT_S=10
CONFIG_ESP_TASK_WDT_EN=y

# --- Flash / Partitions ---
CONFIG_ESPTOOLPY_FLASHSIZE_16MB=y
CONFIG_PARTITION_TABLE_CUSTOM=y
CONFIG_PARTITION_TABLE_CUSTOM_FILENAME="partitions.csv"

# --- PSRAM ---
CONFIG_ESP32S3_SPIRAM_SUPPORT=y
CONFIG_SPIRAM_MODE_OCT=y
CONFIG_SPIRAM_SPEED_80M=y

# --- WiFi ---
CONFIG_ESP_WIFI_STATIC_RX_BUFFER_NUM=10
CONFIG_ESP_WIFI_DYNAMIC_RX_BUFFER_NUM=32

# --- MQTT ---
CONFIG_MQTT_PROTOCOL_5=y
CONFIG_MQTT_BUFFER_SIZE=1024
CONFIG_MQTT_TASK_STACK_SIZE=6144

# --- NVS ---
CONFIG_NVS_ENCRYPTION=y

# --- Logging (dev defaults, overridden in prod) ---
CONFIG_LOG_DEFAULT_LEVEL_DEBUG=y
CONFIG_LOG_MAXIMUM_LEVEL_VERBOSE=y

# --- mbedTLS ---
CONFIG_MBEDTLS_HARDWARE_AES=y
CONFIG_MBEDTLS_HARDWARE_SHA=y
CONFIG_MBEDTLS_TLS_CLIENT_ONLY=y

# --- SPIFFS ---
CONFIG_SPIFFS_MAX_PARTITIONS=1

# --- Watchdog ---
CONFIG_ESP_INT_WDT_TIMEOUT_MS=300
```
